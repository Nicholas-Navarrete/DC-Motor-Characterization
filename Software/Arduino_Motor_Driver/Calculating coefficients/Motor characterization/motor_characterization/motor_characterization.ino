/*
 * motor_characterization.ino
 * --------------------------
 * Drives a brushed DC motor via an L293D H-bridge using a 20 kHz hardware
 * PWM signal on pin D9 (Timer 1 / OC1A) generated by the AVR_PWM library.
 * This mirrors the working Arduino_Motor_Driver.ino which also uses pin D9.
 * Wire D9 to L293D pin 1 (1,2EN – PWM enable).
 *
 * Square-wave profile: 100% duty for 5 s → 0% duty for 5 s → repeat.
 *
 * L293D wiring (per schematic):
 *   D9  → pin 1  (1,2EN  – PWM enable)
 *   D7  → pin 2  (1A     – direction)
 *   D8  → pin 7  (2A     – direction)
 *   Motor between pins 3 (1Y) and 6 (2Y)
 *   D7=HIGH, D8=LOW drives the motor forward during the ON phase.
 *   Swap D7/D8 logic levels if the motor spins the wrong direction.
 *
 * Sensor inputs:
 *   A0 – INA180A3 current-sense amplifier output (0.05 Ω shunt, 100 V/V gain)
 *   A1 – AD823 op-amp output (optical tachometer)
 *
 * Every measurement group is transmitted as an 11-byte binary packet
 * at 500 000 baud for maximum throughput.
 *
 * Packet format (11 bytes, big-endian):
 *   [0]      0xBB           sync byte
 *   [1-2]    uint16_t       A0 raw ADC  (current sense, 0–1023)
 *   [3-4]    uint16_t       A1 raw ADC  (encoder,       0–1023)
 *   [5]      uint8_t        commanded duty cycle (0 or 100 %)
 *   [6-9]    uint32_t       delta time since last packet (µs, big-endian)
 *   [10]     0xEE           end byte (framing sanity check)
 *
 * Library dependency:
 *   AVR_PWM by khoih-prog — install via Arduino Library Manager.
 *   Search "AVR_PWM" and install v1.2.0 or later.
 *
 * Notes:
 *   • D9 is backed by Timer 1 (OC1A) on the ATmega328P.
 *   • Duty cycle updates use setPWM(pin, freq, dutyCycle_float) — the same
 *     call pattern used in the working Arduino_Motor_Driver.ino.
 *   • ADC prescaler is set to 16 → ~13 µs per conversion @ 16 MHz.
 */

#include "AVR_PWM.h"

// ── Pin assignments ───────────────────────────────────────────────────────────
#define motorPWM_pin   9      // D9 – matches Arduino_Motor_Driver.ino exactly
static const uint8_t PIN_DIR_A   = 7;    // D7 – L293D 1A  (direction)
static const uint8_t PIN_DIR_B   = 8;    // D8 – L293D 2A  (direction)
static const uint8_t PIN_CURRENT = A0;   // INA180 output → current sense
static const uint8_t PIN_ENCODER = A1;   // AD823 output  → optical encoder

// ── PWM configuration ─────────────────────────────────────────────────────────
static const float PWM_FREQ_HZ = 20000.0f;   // 20 kHz carrier

// Library instance — created in setup(), used everywhere via setPWM()
AVR_PWM* PWM_Instance = nullptr;

// ── Serial packet framing ─────────────────────────────────────────────────────
static const uint8_t SYNC_BYTE = 0xBB;
static const uint8_t END_BYTE  = 0xEE;

// ── Square-wave timing ────────────────────────────────────────────────────────
static const unsigned long ON_TIME_MS  = 5000UL;  // 5 s at 100 %
static const unsigned long OFF_TIME_MS = 5000UL;  // 5 s at   0 %

// ── Runtime state ─────────────────────────────────────────────────────────────
static unsigned long lastMicros   = 0;
static unsigned long phaseStartMs = 0;
static uint8_t       dutyPercent  = 100;  // current phase: 0 or 100

// ─────────────────────────────────────────────────────────────────────────────
// setDuty() — mirrors TaskWriteMotors() in Arduino_Motor_Driver.ino exactly:
//   float dutycycle = MotorValue * 100.0f / 255.0f;
//   PWM_Instance->setPWM(motorPWM_pin, 20000.0, dutycycle);
// Here we simply pass 100.0 or 0.0 directly.
// ─────────────────────────────────────────────────────────────────────────────
static inline void setDuty(uint8_t pct) {
  PWM_Instance->setPWM(motorPWM_pin, PWM_FREQ_HZ, pct ? 100.0f : 0.0f);
}

// ─────────────────────────────────────────────────────────────────────────────
void setup() {
  Serial.begin(500000);

  // ── Direction pins: D7=HIGH / D8=LOW → forward rotation ──────────────────
  pinMode(PIN_DIR_A, OUTPUT);
  pinMode(PIN_DIR_B, OUTPUT);
  digitalWrite(PIN_DIR_A, HIGH);
  digitalWrite(PIN_DIR_B, LOW);

  // ── AVR_PWM: initialise pin 9 at 20 kHz, 0% duty then ramp to 100% ───────
  // Matches motor driver: new AVR_PWM(motorPWM_pin, 20000.0, 0)
  PWM_Instance = new AVR_PWM(motorPWM_pin, PWM_FREQ_HZ, 0.0f);
  if (PWM_Instance == nullptr) {
    pinMode(LED_BUILTIN, OUTPUT);
    while (true) {
      digitalWrite(LED_BUILTIN, !digitalRead(LED_BUILTIN));
      delay(100);
    }
  }

  // Start the first ON phase at 100%
  setDuty(100);

  // ── ADC: set prescaler to 16 for ~13 µs conversions ──────────────────────
  // Default prescaler 128 → ~112 µs; prescaler 16 → ~13 µs.
  // Bits ADPS2:ADPS1:ADPS0 = 1:0:0 for prescaler 16.
  ADCSRA = (ADCSRA & ~0x07) | 0x04;

  // Warm-up reads to settle the sample-and-hold capacitor
  analogRead(PIN_CURRENT);
  analogRead(PIN_ENCODER);

  // ── Initialise timing state ───────────────────────────────────────────────
  dutyPercent  = 100;
  phaseStartMs = millis();
  lastMicros   = micros();
}

// ─────────────────────────────────────────────────────────────────────────────
void loop() {
  // ── 1. Square-wave phase management ──────────────────────────────────────
  unsigned long nowMs   = millis();
  unsigned long elapsed = nowMs - phaseStartMs;

  if (dutyPercent == 100 && elapsed >= ON_TIME_MS) {
    dutyPercent  = 0;
    setDuty(0);
    phaseStartMs = nowMs;
  } else if (dutyPercent == 0 && elapsed >= OFF_TIME_MS) {
    dutyPercent  = 100;
    setDuty(100);
    phaseStartMs = nowMs;
  }

  // ── 2. Sample ADC channels and record timestamp ───────────────────────────
  unsigned long nowUs  = micros();
  uint16_t adcCurrent  = (uint16_t)analogRead(PIN_CURRENT);  // A0
  uint16_t adcEncoder  = (uint16_t)analogRead(PIN_ENCODER);  // A1
  uint32_t deltaMicros = (uint32_t)(nowUs - lastMicros);
  lastMicros           = nowUs;

  // ── 3. Transmit 11-byte binary measurement packet (all big-endian) ────────
  Serial.write(SYNC_BYTE);

  Serial.write((uint8_t)(adcCurrent >> 8));    // A0 high byte
  Serial.write((uint8_t)(adcCurrent & 0xFF));  // A0 low  byte

  Serial.write((uint8_t)(adcEncoder >> 8));    // A1 high byte
  Serial.write((uint8_t)(adcEncoder & 0xFF));  // A1 low  byte

  Serial.write(dutyPercent);                   // commanded duty %  (0 or 100)

  Serial.write((uint8_t)(deltaMicros >> 24));  // Δt byte 3 (MSB)
  Serial.write((uint8_t)(deltaMicros >> 16));  // Δt byte 2
  Serial.write((uint8_t)(deltaMicros >>  8));  // Δt byte 1
  Serial.write((uint8_t)(deltaMicros));        // Δt byte 0 (LSB)

  Serial.write(END_BYTE);
}
